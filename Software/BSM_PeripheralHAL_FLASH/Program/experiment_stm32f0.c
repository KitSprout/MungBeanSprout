/*=====================================================================================================*/
/*=====================================================================================================*/
#include "Dirvers\stm32f0_system.h"
#include "Dirvers\stm32f0_flash.h" 
#include "Algorithms\algorithm_compare.h"

#include "experiment_stm32f0.h"
/*=====================================================================================================*/
/*=====================================================================================================*/
#define GPIO_LED_PINs       GPIO_PIN_0 | GPIO_PIN_1 | GPIO_PIN_2
#define GPIO_LED_GPIO_PORT  GPIOA

#define LED_0_Set           HAL_GPIO_WritePin(GPIO_LED_GPIO_PORT, GPIO_PIN_0, GPIO_PIN_SET)
#define LED_0_Reset         HAL_GPIO_WritePin(GPIO_LED_GPIO_PORT, GPIO_PIN_0, GPIO_PIN_RESET)
#define LED_0_Toggle        HAL_GPIO_TogglePin(GPIO_LED_GPIO_PORT, GPIO_PIN_0)

#define LED_1_Set           HAL_GPIO_WritePin(GPIO_LED_GPIO_PORT, GPIO_PIN_1, GPIO_PIN_SET)
#define LED_1_Reset         HAL_GPIO_WritePin(GPIO_LED_GPIO_PORT, GPIO_PIN_1, GPIO_PIN_RESET)
#define LED_1_Toggle        HAL_GPIO_TogglePin(GPIO_LED_GPIO_PORT, GPIO_PIN_1)

#define LED_2_Set           HAL_GPIO_WritePin(GPIO_LED_GPIO_PORT, GPIO_PIN_2, GPIO_PIN_SET)
#define LED_2_Reset         HAL_GPIO_WritePin(GPIO_LED_GPIO_PORT, GPIO_PIN_2, GPIO_PIN_RESET)
#define LED_2_Toggle        HAL_GPIO_TogglePin(GPIO_LED_GPIO_PORT, GPIO_PIN_2)

#define GPIO_A_Set          HAL_GPIO_WritePin(GPIO_LED_GPIO_PORT, GPIO_LED_PINs, GPIO_PIN_SET)
#define GPIO_A_Reset        HAL_GPIO_WritePin(GPIO_LED_GPIO_PORT, GPIO_LED_PINs, GPIO_PIN_RESET)
#define GPIO_A_Toggle       HAL_GPIO_TogglePin(GPIO_LED_GPIO_PORT, GPIO_LED_PINs)
/*=====================================================================================================*/
/*=====================================================================================================*/
#define FLASH_RW_U8  1
#define FLASH_RW_U16 0
#define FLASH_RW_U32 0

#define WRITE_PAGE 15

#if FLASH_RW_U8
uint8_t ReadDataU8[1024] = {0};
uint8_t WriteDataU8[1024] = {
  1,2,3,4,5,6,7,8,9,10,11,12,13,14,15,16,1,2,3,4,5,6,7,8,9,10,11,12,13,14,15,16,1,2,3,4,5,6,7,8,9,10,11,12,13,14,15,16,1,2,3,4,5,6,7,8,9,10,11,12,13,14,15,16,
  1,2,3,4,5,6,7,8,9,10,11,12,13,14,15,16,1,2,3,4,5,6,7,8,9,10,11,12,13,14,15,16,1,2,3,4,5,6,7,8,9,10,11,12,13,14,15,16,1,2,3,4,5,6,7,8,9,10,11,12,13,14,15,16,
  1,2,3,4,5,6,7,8,9,10,11,12,13,14,15,16,1,2,3,4,5,6,7,8,9,10,11,12,13,14,15,16,1,2,3,4,5,6,7,8,9,10,11,12,13,14,15,16,1,2,3,4,5,6,7,8,9,10,11,12,13,14,15,16,
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  1,2,3,4,5,6,7,8,9,10,11,12,13,14,15,16,1,2,3,4,5,6,7,8,9,10,11,12,13,14,15,16,1,2,3,4,5,6,7,8,9,10,11,12,13,14,15,16,1,2,3,4,5,6,7,8,9,10,11,12,13,14,15,16
};
#endif

#if FLASH_RW_U16
uint16_t ReadDataU16[512] = {0};
uint16_t WriteDataU16[512] = {
  1,2,3,4,5,6,7,8,9,10,11,12,13,14,15,16,1,2,3,4,5,6,7,8,9,10,11,12,13,14,15,16,1,2,3,4,5,6,7,8,9,10,11,12,13,14,15,16,1,2,3,4,5,6,7,8,9,10,11,12,13,14,15,16,
  1,2,3,4,5,6,7,8,9,10,11,12,13,14,15,16,1,2,3,4,5,6,7,8,9,10,11,12,13,14,15,16,1,2,3,4,5,6,7,8,9,10,11,12,13,14,15,16,1,2,3,4,5,6,7,8,9,10,11,12,13,14,15,16,
  1,2,3,4,5,6,7,8,9,10,11,12,13,14,15,16,1,2,3,4,5,6,7,8,9,10,11,12,13,14,15,16,1,2,3,4,5,6,7,8,9,10,11,12,13,14,15,16,1,2,3,4,5,6,7,8,9,10,11,12,13,14,15,16,
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  1,2,3,4,5,6,7,8,9,10,11,12,13,14,15,16,1,2,3,4,5,6,7,8,9,10,11,12,13,14,15,16,1,2,3,4,5,6,7,8,9,10,11,12,13,14,15,16,1,2,3,4,5,6,7,8,9,10,11,12,13,14,15,16
};
#endif

#if FLASH_RW_U32
uint32_t ReadDataU32[256] = {0};
uint32_t WriteDataU32[256] = {
  1,2,3,4,5,6,7,8,9,10,11,12,13,14,15,16,1,2,3,4,5,6,7,8,9,10,11,12,13,14,15,16,1,2,3,4,5,6,7,8,9,10,11,12,13,14,15,16,1,2,3,4,5,6,7,8,9,10,11,12,13,14,15,16,
  1,2,3,4,5,6,7,8,9,10,11,12,13,14,15,16,1,2,3,4,5,6,7,8,9,10,11,12,13,14,15,16,1,2,3,4,5,6,7,8,9,10,11,12,13,14,15,16,1,2,3,4,5,6,7,8,9,10,11,12,13,14,15,16,
  1,2,3,4,5,6,7,8,9,10,11,12,13,14,15,16,1,2,3,4,5,6,7,8,9,10,11,12,13,14,15,16,1,2,3,4,5,6,7,8,9,10,11,12,13,14,15,16,1,2,3,4,5,6,7,8,9,10,11,12,13,14,15,16,
  1,2,3,4,5,6,7,8,9,10,11,12,13,14,15,16,1,2,3,4,5,6,7,8,9,10,11,12,13,14,15,16,1,2,3,4,5,6,7,8,9,10,11,12,13,14,15,16,1,2,3,4,5,6,7,8,9,10,11,12,13,14,15,16
};
#endif
/*=====================================================================================================*/
/*=====================================================================================================*/
int main( void )
{
  HAL_Init();
  GPIO_Config();

#if FLASH_RW_U8
  Flash_ErasePages(FLASH_PAGE_ADDR(WRITE_PAGE), 1);
  Flash_WritePageU8(FLASH_PAGE_ADDR(WRITE_PAGE), WriteDataU8, 1024);
  Flash_ReadPageU8(FLASH_PAGE_ADDR(WRITE_PAGE), ReadDataU8, 1024);
  if(Cmp_ArrU8(WriteDataU8, ReadDataU8, 1024) != SUCCESS)
    LED_0_Reset;
#endif

#if FLASH_RW_U16
  Flash_ErasePages(FLASH_PAGE_ADDR(WRITE_PAGE), 1);
  Flash_WritePageU16(FLASH_PAGE_ADDR(WRITE_PAGE), WriteDataU16, 512);
  Flash_ReadPageU16(FLASH_PAGE_ADDR(WRITE_PAGE), ReadDataU16, 512);
  if(Cmp_ArrU16(WriteDataU16, ReadDataU16, 512) != SUCCESS)
    LED_1_Reset;
#endif

#if FLASH_RW_U32
  Flash_ErasePages(FLASH_PAGE_ADDR(WRITE_PAGE), 1);
  Flash_WritePageU32(FLASH_PAGE_ADDR(WRITE_PAGE), WriteDataU32, 256);
  Flash_ReadPageU32(FLASH_PAGE_ADDR(WRITE_PAGE), ReadDataU32, 256);
  if(Cmp_ArrU32(WriteDataU32, ReadDataU32, 256) != SUCCESS)
    LED_2_Reset;
#endif

  while (1) {
    GPIO_A_Toggle;
    Delay_100ms(1);
  }
}
/*=====================================================================================================*/
/*=====================================================================================================*/
void GPIO_Config( void )
{
  GPIO_InitTypeDef GPIO_InitStruct;

  /* GPIO Clk ******************************************************************/
  __GPIOA_CLK_ENABLE();
  __GPIOB_CLK_ENABLE();

  /* GPIO Pin ******************************************************************/
  GPIO_InitStruct.Mode  = GPIO_MODE_OUTPUT_PP;
  GPIO_InitStruct.Pull  = GPIO_PULLUP;
  GPIO_InitStruct.Speed = GPIO_SPEED_HIGH;

  GPIO_InitStruct.Pin   = GPIO_LED_PINs;
  HAL_GPIO_Init(GPIO_LED_GPIO_PORT, &GPIO_InitStruct);

  /* GPIO Pin ******************************************************************/
  GPIO_A_Set;
}
/*=====================================================================================================*/
/*=====================================================================================================*/
