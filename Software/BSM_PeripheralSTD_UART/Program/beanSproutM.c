/*=====================================================================================================*/
/*=====================================================================================================*/
#include "drivers\stm32f0_system.h"
#include "modules\module_serial.h"

#include "beanSproutM.h"
/*=====================================================================================================*/
/*=====================================================================================================*/
void BSM_Init( void )
{
  SystemInit();
  HAL_InitTick();

  BSM_GPIO_Config();
  BSM_UART_Config(NULL);
}
/*=====================================================================================================*/
/*=====================================================================================================*/
void Serial_demo( void )
{
  static uint8_t i = 0;

  uint8_t recvData = 0;
  int8_t state = Serial_RecvDataWTO(&recvData, 1, 500);

  if(state == ERROR) {
    printf("Timeout ... %d\r\n", i);
    i = (i == 255) ? 0 : i + 1;
  }
  else if(recvData == 0x0D) { // if press enter
    Serial_SendStr("\r\n");
  }
  else {
    Serial_SendData(&recvData, 1);
  }
}

void BSM_Loop( void )
{
  while(1) {
    Serial_demo();
  }
}
/*=====================================================================================================*/
/*=====================================================================================================*/
